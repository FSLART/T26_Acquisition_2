/* USER CODE BEGIN Header */
/**
  ******************************************************************************
  * @file           : main.c
  * @brief          : Main program body
  ******************************************************************************
  * @attention
  *
  * Copyright (c) 2026 STMicroelectronics.
  * All rights reserved.
  *
  * This software is licensed under terms that can be found in the LICENSE file
  * in the root directory of this software component.
  * If no LICENSE file comes with this software, it is provided AS-IS.
  *
  ******************************************************************************
  */
/* USER CODE END Header */
/* Includes ------------------------------------------------------------------*/
#include "main.h"
#include "can.h"
#include "dma.h"
#include "i2c.h"
#include "iwdg.h"
#include "tim.h"
#include "usart.h"
#include "gpio.h"

/* Private includes ----------------------------------------------------------*/
/* USER CODE BEGIN Includes */
#include <stdio.h>
#include <math.h>
#include <string.h>
#include "data_t26.h"   // Generated by cantools from DBC (AQT2 message, etc.)
#include "mlx90641.h"
#include "thermal_can.h"
#include "wheel_speed.h"

/* USER CODE END Includes */

/* Private typedef -----------------------------------------------------------*/
/* USER CODE BEGIN PTD */

/* USER CODE END PTD */

/* Private define ------------------------------------------------------------*/
/* USER CODE BEGIN PD */
// CAN fault must last this long before CAN1 is fully restarted (ABOM normally clears bus-off in a few ms)
#define CAN_RECOVER_MS  200
#define CAN_DEBUG_ITS   (CAN_IT_TX_MAILBOX_EMPTY | CAN_IT_ERROR_WARNING | CAN_IT_ERROR_PASSIVE | \
                         CAN_IT_BUSOFF | CAN_IT_LAST_ERROR_CODE | CAN_IT_ERROR)

// 1 = read the MLX90641 (non-blocking: I2C by interrupt + DMA) and stream it on CAN
#define INFRARED_CAMERA_ENABLE  1

/* USER CODE END PD */

/* Private macro -------------------------------------------------------------*/
/* USER CODE BEGIN PM */

/* USER CODE END PM */

/* Private variables ---------------------------------------------------------*/

/* USER CODE BEGIN PV */
volatile uint32_t time_ms = 0;

// --- DEBUG SNAPSHOT (add "aqt2" to Live Expressions) ---
typedef struct {
    uint32_t time_ms;
    uint8_t  iwdg_reset;            // 1 = last reset was caused by the watchdog
    uint8_t  wheel_speed_self_check;    // 1 = rpm calculation passed its boot test
    WheelSpeed wheel[2];            // copy of wheel_speed[]: [0] = PB0 front left, [1] = PB1 front right
    struct {
        uint32_t tx_queued;         // 0x720 AQT2 frames queued (every 10 ms from the TIM7 interrupt)
        uint32_t tx_queue_fail;     // 0x720 not queued (no free mailbox / CAN not running)
        uint32_t wheel_frame_max_gap_ms;    // longest interval between two queued 0x720 frames (expected 10)
        uint32_t tx_ok;             // frame ACKed on the bus
        uint32_t err_count;         // HAL_CAN_ErrorCallback hits
        uint32_t recover_count;     // CAN1 restarts done by can_watchdog()
        uint32_t last_error;        // HAL_CAN_ERROR_* bits of the latest error (0x20 ACK, 0x08 stuff, 0x10 form,
                                    // 0x40/0x80 bit rec/dom, 0x100 CRC, 0x04 bus-off, 0x1000 TX_TERR0...)
        uint32_t error_flags;       // every HAL_CAN_ERROR_* bit seen since boot
        uint8_t  tec;               // transmit error counter (>=128 passive, >255 bus-off)
        uint8_t  rec;               // receive error counter
        uint8_t  bus_off;
        uint8_t  error_passive;
        uint8_t  error_warning;
        uint8_t  free_mailboxes;    // 0..3
        uint8_t  state;             // HAL_CAN_StateTypeDef (2 = LISTENING = running)
        uint8_t  last_tx[8];        // payload of the last queued 0x720 frame
    } can;
    MLX90641 mlx;                   // IR array on I2C3, copy of mlx90641 (see mlx90641.h)
} DebugData;

volatile DebugData aqt2;

// Tasks Prototypes
void execute_immediate_tasks(void);
void execute_10ms_tasks(void);
void execute_50ms_tasks(void);
void execute_100ms_tasks(void);

/* USER CODE END PV */

/* Private function prototypes -----------------------------------------------*/
void SystemClock_Config(void);
/* USER CODE BEGIN PFP */

int _write(int file, char *data, int len) {
    HAL_UART_Transmit(&huart1, (uint8_t*) data, len, HAL_MAX_DELAY);
    return len;
}

/* USER CODE END PFP */

/* Private user code ---------------------------------------------------------*/
/* USER CODE BEGIN 0 */
// AQT2 (0x720, front wheel rpm, raw = rpm). Sent every 10 ms from the TIM7 interrupt, so nothing in
// the main loop can delay it. thermal_can.c leaves one TX mailbox free and queues under a critical section.
static void send_wheel_speed_frame(void) {
    static uint32_t last_queued_ms;
    CAN_TxHeaderTypeDef header = { .StdId = DATA_T26_AQT2_FRAME_ID, .IDE = CAN_ID_STD,
                                   .RTR = CAN_RTR_DATA, .DLC = DATA_T26_AQT2_LENGTH };
    uint8_t payload[8];
    uint32_t mailbox;

    wheel_speed_update();
    struct data_t26_aqt2_t message = {
        .front_left_wheel_rpm  = (uint16_t)(wheel_speed[0].rpm + 0.5f),
        .front_right_wheel_rpm = (uint16_t)(wheel_speed[1].rpm + 0.5f),
    };
    data_t26_aqt2_pack(payload, &message, sizeof(payload));

    if (HAL_CAN_AddTxMessage(&hcan1, &header, payload, &mailbox) != HAL_OK) {
        aqt2.can.tx_queue_fail++;
        return;
    }
    if (aqt2.can.tx_queued && time_ms - last_queued_ms > aqt2.can.wheel_frame_max_gap_ms) {
        aqt2.can.wheel_frame_max_gap_ms = time_ms - last_queued_ms;
    }
    last_queued_ms = time_ms;
    aqt2.can.tx_queued++;
    memcpy((void *)aqt2.can.last_tx, payload, DATA_T26_AQT2_LENGTH);
}

void HAL_TIM_PeriodElapsedCallback(TIM_HandleTypeDef* htim){
    if (htim->Instance == TIM7) {
        time_ms++;
        if (time_ms % 10 == 0) {
            send_wheel_speed_frame();
        }
    } else if (htim->Instance == TIM3) {
        wheel_speed_timer_overflow();
    }
}

// Rising edges on PB0 (TIM3_CH3) and PB1 (TIM3_CH4)
void HAL_TIM_IC_CaptureCallback(TIM_HandleTypeDef *htim) {
    if (htim->Instance != TIM3) {
        return;
    }
    if (htim->Channel == HAL_TIM_ACTIVE_CHANNEL_3) {
        wheel_speed_capture(0, HAL_TIM_ReadCapturedValue(htim, TIM_CHANNEL_3));
    }
    if (htim->Channel == HAL_TIM_ACTIVE_CHANNEL_4) {
        wheel_speed_capture(1, HAL_TIM_ReadCapturedValue(htim, TIM_CHANNEL_4));
    }
}

// CAN debug callbacks (need HAL_CAN_ActivateNotification in main)
void HAL_CAN_TxMailbox0CompleteCallback(CAN_HandleTypeDef *hcan) { aqt2.can.tx_ok++; }
void HAL_CAN_TxMailbox1CompleteCallback(CAN_HandleTypeDef *hcan) { aqt2.can.tx_ok++; }
void HAL_CAN_TxMailbox2CompleteCallback(CAN_HandleTypeDef *hcan) { aqt2.can.tx_ok++; }

void HAL_CAN_ErrorCallback(CAN_HandleTypeDef *hcan) {
    aqt2.can.err_count++;
    aqt2.can.last_error = hcan->ErrorCode;
    aqt2.can.error_flags |= hcan->ErrorCode;
    HAL_CAN_ResetError(hcan);
}
/* USER CODE END 0 */

/**
  * @brief  The application entry point.
  * @retval int
  */
int main(void)
{

  /* USER CODE BEGIN 1 */

  /* USER CODE END 1 */

  /* MCU Configuration--------------------------------------------------------*/

  /* Reset of all peripherals, Initializes the Flash interface and the Systick. */
  HAL_Init();

  /* USER CODE BEGIN Init */

  /* USER CODE END Init */

  /* Configure the system clock */
  SystemClock_Config();

  /* USER CODE BEGIN SysInit */

  /* USER CODE END SysInit */

  /* Initialize all configured peripherals */
  MX_GPIO_Init();
  MX_DMA_Init();
  MX_CAN1_Init();
  MX_USART1_UART_Init();
  MX_TIM7_Init();
  MX_IWDG_Init();
  MX_TIM3_Init();
  MX_I2C3_Init();
  /* USER CODE BEGIN 2 */
  aqt2.wheel_speed_self_check = wheel_speed_self_check();
  HAL_TIM_Base_Start_IT(&htim7);    // 1 ms tick + 0x720 every 10 ms
  wheel_speed_start();              // input capture on PB0/PB1

  // Debug: TX-complete + error interrupts feed aqt2.can
  HAL_CAN_ActivateNotification(&hcan1, CAN_DEBUG_ITS);

  aqt2.iwdg_reset = __HAL_RCC_GET_FLAG(RCC_FLAG_IWDGRST);
  __HAL_RCC_CLEAR_RESET_FLAGS();

  /* USER CODE END 2 */

  /* Infinite loop */
  /* USER CODE BEGIN WHILE */
    while (1) {
    /* USER CODE END WHILE */

    /* USER CODE BEGIN 3 */

        // Execute immediate tasks
        execute_immediate_tasks();

        static uint32_t previus_tick_10ms = 0;
        static uint32_t previus_tick_50ms = 0;
        static uint32_t previus_tick_100ms = 0;

        // Execute 10ms Tasks
        if (time_ms - previus_tick_10ms >= 10) {
            execute_10ms_tasks();
            previus_tick_10ms = time_ms;
        }

        // Execute 50ms Tasks
        if (time_ms - previus_tick_50ms >= 50) {
            execute_50ms_tasks();
            previus_tick_50ms = time_ms;
        }

        // Execute 100ms Tasks
        if (time_ms - previus_tick_100ms >= 100) {
            execute_100ms_tasks();
            previus_tick_100ms = time_ms;
        }
    }

  /* USER CODE END 3 */
}

/**
  * @brief System Clock Configuration
  * @retval None
  */
void SystemClock_Config(void)
{
  RCC_OscInitTypeDef RCC_OscInitStruct = {0};
  RCC_ClkInitTypeDef RCC_ClkInitStruct = {0};

  /** Configure the main internal regulator output voltage
  */
  __HAL_RCC_PWR_CLK_ENABLE();
  __HAL_PWR_VOLTAGESCALING_CONFIG(PWR_REGULATOR_VOLTAGE_SCALE1);

  /** Initializes the RCC Oscillators according to the specified parameters
  * in the RCC_OscInitTypeDef structure.
  */
  RCC_OscInitStruct.OscillatorType = RCC_OSCILLATORTYPE_LSI|RCC_OSCILLATORTYPE_HSE;
  RCC_OscInitStruct.HSEState = RCC_HSE_ON;
  RCC_OscInitStruct.LSIState = RCC_LSI_ON;
  RCC_OscInitStruct.PLL.PLLState = RCC_PLL_ON;
  RCC_OscInitStruct.PLL.PLLSource = RCC_PLLSOURCE_HSE;
  RCC_OscInitStruct.PLL.PLLM = 4;
  RCC_OscInitStruct.PLL.PLLN = 96;
  RCC_OscInitStruct.PLL.PLLP = RCC_PLLP_DIV2;
  RCC_OscInitStruct.PLL.PLLQ = 2;
  RCC_OscInitStruct.PLL.PLLR = 2;
  if (HAL_RCC_OscConfig(&RCC_OscInitStruct) != HAL_OK)
  {
    Error_Handler();
  }

  /** Initializes the CPU, AHB and APB buses clocks
  */
  RCC_ClkInitStruct.ClockType = RCC_CLOCKTYPE_HCLK|RCC_CLOCKTYPE_SYSCLK
                              |RCC_CLOCKTYPE_PCLK1|RCC_CLOCKTYPE_PCLK2;
  RCC_ClkInitStruct.SYSCLKSource = RCC_SYSCLKSOURCE_PLLCLK;
  RCC_ClkInitStruct.AHBCLKDivider = RCC_SYSCLK_DIV1;
  RCC_ClkInitStruct.APB1CLKDivider = RCC_HCLK_DIV2;
  RCC_ClkInitStruct.APB2CLKDivider = RCC_HCLK_DIV1;

  if (HAL_RCC_ClockConfig(&RCC_ClkInitStruct, FLASH_LATENCY_3) != HAL_OK)
  {
    Error_Handler();
  }
}

/* USER CODE BEGIN 4 */
void execute_immediate_tasks() {
#if INFRARED_CAMERA_ENABLE
    thermal_can_task();     // streams the 24 AQT2_Temperatures blocks of each new IR frame
#endif
}

// Copy current state into aqt2 (ISR counters are updated in the callbacks)
static void debug_update(void) {
    aqt2.time_ms = time_ms;

    memcpy((void *)aqt2.wheel, wheel_speed, sizeof(wheel_speed));

    uint32_t esr = hcan1.Instance->ESR;
    aqt2.can.tec            = (esr & CAN_ESR_TEC) >> CAN_ESR_TEC_Pos;
    aqt2.can.rec            = (esr & CAN_ESR_REC) >> CAN_ESR_REC_Pos;
    aqt2.can.bus_off        = (esr & CAN_ESR_BOFF) != 0;
    aqt2.can.error_passive  = (esr & CAN_ESR_EPVF) != 0;
    aqt2.can.error_warning  = (esr & CAN_ESR_EWGF) != 0;
    aqt2.can.free_mailboxes = HAL_CAN_GetTxMailboxesFreeLevel(&hcan1);
    aqt2.can.state          = HAL_CAN_GetState(&hcan1);

    memcpy((void *)&aqt2.mlx, &mlx90641, sizeof(mlx90641));
}

// CAN1 watchdog: if the peripheral is not running (Start timed out), stays bus-off
// (hardware ABOM didn't recover) or has all 3 TX mailboxes stuck for CAN_RECOVER_MS,
// restart it from scratch. Keeps retrying every CAN_RECOVER_MS until healthy.
static void can_watchdog(void) {
    static uint32_t last_healthy_ms = 0;

    uint8_t healthy = HAL_CAN_GetState(&hcan1) == HAL_CAN_STATE_LISTENING
                   && !(hcan1.Instance->ESR & CAN_ESR_BOFF)
                   && HAL_CAN_GetTxMailboxesFreeLevel(&hcan1) > 0;

    if (healthy) {
        last_healthy_ms = time_ms;
        return;
    }
    if (time_ms - last_healthy_ms < CAN_RECOVER_MS) {
        return;
    }

    HAL_CAN_DeInit(&hcan1);          // IRQs + clock off, HAL state -> RESET
    __HAL_RCC_CAN1_FORCE_RESET();    // real peripheral reset: DeInit writes MCR_RESET with the clock already off
    __HAL_RCC_CAN1_RELEASE_RESET();
    MX_CAN1_Init();                  // init + filter + start (blocks <= ~30 ms, IWDG is 2 s)
    HAL_CAN_ActivateNotification(&hcan1, CAN_DEBUG_ITS);

    aqt2.can.recover_count++;
    last_healthy_ms = time_ms;       // next attempt only after another CAN_RECOVER_MS
}

void execute_10ms_tasks() {
    HAL_IWDG_Refresh(&hiwdg);
    can_watchdog();
#if INFRARED_CAMERA_ENABLE
    mlx90641_task();
#endif
    debug_update();
}

void execute_50ms_tasks() {
    // 0x720 AQT2 moved to the TIM7 interrupt (send_wheel_speed_frame)
}

void execute_100ms_tasks() {
    HAL_GPIO_TogglePin(HEARTBEAT_GPIO_Port, HEARTBEAT_Pin); // HEARTBEAT

    // Velocity sensor debug (blocking UART, ~4 ms at 115200)
    printf("Wheel 1: %.1f RPM | Wheel 2: %.1f RPM\r\n", wheel_speed[0].rpm, wheel_speed[1].rpm);
}
/* USER CODE END 4 */

/**
  * @brief  This function is executed in case of error occurrence.
  * @retval None
  */
void Error_Handler(void)
{
  /* USER CODE BEGIN Error_Handler_Debug */
    /* User can add his own implementation to report the HAL error return state */
    __disable_irq();
    while (1) {
    }
  /* USER CODE END Error_Handler_Debug */
}
#ifdef USE_FULL_ASSERT
/**
  * @brief  Reports the name of the source file and the source line number
  *         where the assert_param error has occurred.
  * @param  file: pointer to the source file name
  * @param  line: assert_param error line source number
  * @retval None
  */
void assert_failed(uint8_t *file, uint32_t line)
{
  /* USER CODE BEGIN 6 */
  /* User can add his own implementation to report the file name and line number,
     ex: printf("Wrong parameters value: file %s on line %d\r\n", file, line) */
  /* USER CODE END 6 */
}
#endif /* USE_FULL_ASSERT */
